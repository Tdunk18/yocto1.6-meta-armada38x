## conf/machine/388-db-gp-be.conf
```bitbake
#@TYPE: Machine
#@NAME: 388-db-gp-be

#@DESCRIPTION: Machine configuration for Marvell DB-88F6820-GP in Big Endian mode

require conf/machine/include/big-endian.inc

require conf/machine/388-db-gp.conf
```

## conf/machine/388-db-gp.conf
```bitbake
#@TYPE: Machine
#@NAME: 388-db-gp

#@DESCRIPTION: Machine configuration for Marvell DB-88F6820-GP

require conf/machine/include/meta-armada38x.inc

KERNEL_DEVICETREE = "armada-388-db-gp.dtb"

UBOOT_MARVELL_MACHINE = "armada_38x"
```

## conf/machine/armada38x-db.conf
```bitbake
#@TYPE: Machine
#@NAME: armada38x-db

#@DESCRIPTION: Machine configuration for armada38x systems


# Ship all kernel modules by default
MACHINE_EXTRA_RRECOMMENDS += "kernel-modules"
MACHINE_ESSENTIAL_EXTRA_RDEPENDS += "kernel-image kernel-devicetree u-boot-script-dev"

# Build U-Boot as part of a final image, even though it does not affect the RFS
EXTRA_IMAGEDEPENDS += "u-boot"

# Uncomment the following line to enable the hard floating point abi. Note that
# this breaks some binary libraries and 3D (neither of which ship with
# meta-yocto). For maximum compatibility, leave this disabled.
DEFAULTTUNE = "cortexa9hf-neon"
include conf/machine/include/tune-cortexa9.inc

IMAGE_FSTYPES += "tar.bz2 ext2 sdcard"
IMAGE_CLASSES += "image_types_marvell"

SERIAL_CONSOLE = "115200 ttyS0"

PREFERRED_PROVIDER_virtual/kernel ?= "linux-armada38x"
KERNEL_IMAGETYPE = "zImage"
KERNEL_DEVICETREE = "armada-388-db-gp.dtb"

PREFERRED_PROVIDER_u-boot = "u-boot-armada38x"
UBOOT_SUFFIX = "bin"
UBOOT_MACHINE = "armada_38x_config"
UBOOT_MARVELL_MACHINE = "armada_38x"

PREFERRED_PROVIDER_jpeg = "jpeg"
PREFERRED_PROVIDER_jpeg-native = "jpeg-native"

MACHINE_FEATURES = "usbgadget usbhost"
```

## conf/machine/clearfog-be.conf
```bitbake
#@TYPE: Machine
#@NAME: clearfog-be

#@DESCRIPTION: Machine configuration for Solidrun Clearfog in Big Endian mode

require conf/machine/include/big-endian.inc

require conf/machine/clearfog.conf
```

## conf/machine/clearfog.conf
```bitbake
#@TYPE: Machine
#@NAME: clearfog

#@DESCRIPTION: Machine configuration for Solidrun Clearfog

MACHINEOVERRIDES =. "clearfog:"

require conf/machine/include/meta-armada38x.inc

KERNEL_DEVICETREE = "armada-388-customer1.dtb"

UBOOT_MARVELL_MACHINE = "armada_38x_clearfog"
UBOOT_SUFFIX = "mmc"
```

## conf/machine/include/big-endian.inc
```bitbake
EXTRA_IMAGECMD_jffs2 += "--big-endian"
DEFAULTTUNE = "armv7ahfb-neon"
MACHINEOVERRIDES =. "armada38x-be:"
EXTRA_IMAGEDEPENDS_remove = "u-boot"

INHERIT += "blacklist"
PNBLACKLIST[u-boot-armada38x] = "Not supported for big endian"
```
